## meta-aesd/conf/layer.conf
```bitbake
# We have a conf and classes directory, add to BBPATH
BBPATH .= ":${LAYERDIR}"

# We have recipes-* directories, add to BBFILES
BBFILES += "${LAYERDIR}/recipes-*/*/*.bb \
            ${LAYERDIR}/recipes-*/*/*.bbappend"

BBFILE_COLLECTIONS += "meta-aesd"
BBFILE_PATTERN_meta-aesd = "^${LAYERDIR}/"
BBFILE_PRIORITY_meta-aesd = "6"

LAYERDEPENDS_meta-aesd = "core"
LAYERSERIES_COMPAT_meta-aesd = "hardknott kirkstone"

BB_FETCH_TIMEOUT = "200"

BB_ALLOWED_NETWORKS = "download.savannah.gnu.org www.sqlite.org *.gnu.org github.com downloads.yoctoproject.org tukaani.org downloads.sourceforge.net ftp.gnu.org"
```
